//rel_battery HIGH trigger

#include <Thermistor.h>
#include <NTC_Thermistor.h>

#include <SPI.h>
#include <Wire.h>
#include <Adafruit_GFX.h>
#include <Adafruit_SSD1306_STM32.h>
#include <Fonts/FreeSans24pt7b.h>

#define sen_voltage PA5
#define rel_battery PA6
#define interruptPin PA1
#define beeper PB1
#define resetPin PB3



#define FRAME_DELAY (42)
#define FRAME_WIDTH (64)
#define FRAME_HEIGHT (64)
#define FRAME_COUNT (sizeof(frames) / sizeof(frames[0]))

#define Reset 4
Adafruit_SSD1306 display(Reset);


#define SENSOR_PIN PA3
#define REFERENCE_RESISTANCE 9900
#define NOMINAL_RESISTANCE 9988
#define NOMINAL_TEMPERATURE 48
#define B_VALUE 4190
#define STM32_ANALOG_RESOLUTION 4095

Thermistor* thermistor;

// const byte interruptPin = 2;



float voltage;
float temperature;
int frame = 0;


const unsigned char thermometer[] PROGMEM = {
  0x00, 0x00, 0x00, 0x00, 0x00, 0x00, 0x00, 0x00, 0x00, 0x00, 0x00, 0x00, 0x00, 0x00, 0x00, 0x00,
  0x00, 0x00, 0x00, 0x00, 0x00, 0x00, 0x00, 0x00, 0x00, 0x00, 0x00, 0x00, 0x00, 0x00, 0x00, 0x00,
  0x00, 0x00, 0x00, 0x00, 0x00, 0x00, 0x00, 0x00, 0x00, 0x00, 0x00, 0x00, 0x00, 0x00, 0x00, 0x00,
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  0x00, 0x00, 0x00, 0x00, 0x00, 0x00, 0x00, 0x00, 0x00, 0x00, 0x00, 0x00, 0x00, 0x00, 0x00, 0x00
};
const unsigned char battery[] PROGMEM = {
  0x00, 0x03, 0xff, 0xf0, 0x00, 0x00, 0x00, 0x00, 0x00, 0x00, 0x00, 0x00, 0x00, 0x00, 0x00, 0x00,
  0x00, 0x07, 0xff, 0xf8, 0x00, 0x00, 0x00, 0x00, 0x00, 0x00, 0x00, 0x00, 0x00, 0x00, 0x00, 0x00,
  0x00, 0x0e, 0x00, 0x38, 0x00, 0x00, 0x00, 0x00, 0x00, 0x00, 0x00, 0x00, 0x00, 0x00, 0x00, 0x00,
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  0x07, 0xff, 0xff, 0xff, 0xf0, 0x00, 0x00, 0x00, 0x00, 0x00, 0x00, 0x00, 0x00, 0x00, 0x00, 0x00
};



float readVoltage() {
  voltage = analogRead(sen_voltage);
  float voltageConverted = (voltage * 18.8) / 4095;
  return voltageConverted;
}
void showVoltage(float volts) {
  float percentage;


  percentage = map((volts * 10), 115, 128, 0, 1000);
  if (percentage < 0) percentage = 0;

  if ((volts * 10) > 133) {
    for (int i = 0; i < 10; i++) {
      delay(300);
      display.fillRect(32, 7, 20, 26, WHITE);
      display.display();

      delay(300);
      display.fillRect(53, 7, 20, 26, WHITE);
      display.display();

      delay(300);
      display.fillRect(74, 7, 20, 26, WHITE);
      display.display();

      delay(300);
      display.clearDisplay();
      display.drawRoundRect(30, 5, 66, 30, 2, WHITE);
      display.fillRect(96, 14, 5, 12, WHITE);
      display.display();

      display.setTextSize(2);
      display.setCursor(35, 50);
      display.print(volts, 1);
      display.setTextSize(1);
      display.setCursor(85, 56);
      display.print("V");
      display.display();
    }
  } else {
    display.clearDisplay();
    display.setTextColor(WHITE);
    display.drawBitmap(0, 0, battery, 128, 64, WHITE);
    display.setCursor(9, 26);
    display.setTextSize(2);
    if (percentage >= 1000) {
      percentage = 1000;
      display.setTextSize(1);
    } else {
      display.setTextSize(2);
    }
    display.print(percentage / 10, 0);
    display.setTextSize(2);
    display.setCursor(76, 27);
    display.print(volts, 1);
    display.setCursor(78, 50);
    display.setTextSize(1);
    display.print("volts");
    display.display();
    delay(10000);
  }
}
double readTemperature() {
  const double celsius = thermistor->readCelsius();
}
void showTemperature(float temp) {
  display.clearDisplay();
  display.setTextColor(WHITE);
  display.drawBitmap(0, 0, thermometer, 128, 64, WHITE);
  display.setCursor(12, 22);
  display.setTextSize(3);
  display.print(temp, 0);
  display.setTextSize(1);
  display.print("o");
  display.display();
  delay(10000);
}
void powerOff() {
  display.clearDisplay();
  display.setTextColor(WHITE);
  display.setCursor(13, 24);
  display.setTextSize(2);
  display.print("POWER OFF");
  display.display();
  display.setTextSize(1);

  digitalWrite(rel_battery, LOW);
  delay(10000);
}



//bitmap logo chevrolet
const unsigned char chevy[] PROGMEM = {
  0x00, 0x00, 0x00, 0x00, 0x00, 0x00, 0x00, 0x00, 0x00, 0x00, 0x00, 0x00, 0x00, 0x00, 0x00, 0x00,
  0x00, 0x00, 0x00, 0x00, 0x00, 0x00, 0x00, 0x00, 0x00, 0x00, 0x00, 0x00, 0x00, 0x00, 0x00, 0x00,
  0x00, 0x00, 0x00, 0x00, 0x00, 0x00, 0x00, 0x00, 0x00, 0x00, 0x00, 0x00, 0x00, 0x00, 0x00, 0x00,
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  0x00, 0x00, 0x00, 0x00, 0x00, 0x00, 0x00, 0x00, 0x00, 0x00, 0x00, 0x00, 0x00, 0x00, 0x00, 0x00
};


const byte PROGMEM frames[][512] = {
  { 0, 0, 0, 0, 0, 0, 0, 0, 0, 0, 0, 0, 0,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 0, 0 },
  { 0, 0, 0, 0, 0, 0, 0, 0, 0, 0, 0, 0, 0,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 0, 0 },
  { 0, 0, 0, 0, 0, 0, 0, 0, 0, 0, 0, 0, 0,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 0, 0 },
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  { 0, 0, 0, 0, 0, 0, 0, 0, 0, 0, 0, 0, 0,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 0, 0 }
};


void showWarning() {
  for (int i = 0; i < 15; i++) {

    display.clearDisplay();
    display.drawBitmap(32, 0, frames[frame], FRAME_WIDTH, FRAME_HEIGHT, 1);
    display.display();
    frame = (frame + 1) % FRAME_COUNT;
    delay(FRAME_DELAY);
  }
}
void resetFunc() {
  delay(1000);
  digitalWrite(resetPin, LOW);
  delay(1000);
  digitalWrite(resetPin, HIGH);
}


void setup() {
  pinMode(sen_voltage, INPUT);
  pinMode(rel_battery, OUTPUT);
  pinMode(interruptPin, INPUT_PULLDOWN);
  pinMode(beeper, OUTPUT);
  pinMode(PC13, OUTPUT);
  digitalWrite(PC13, LOW);

  attachInterrupt(digitalPinToInterrupt(interruptPin), powerOff, CHANGE);


  thermistor = new NTC_Thermistor(
    SENSOR_PIN,
    REFERENCE_RESISTANCE,
    NOMINAL_RESISTANCE,
    NOMINAL_TEMPERATURE,
    B_VALUE,
    STM32_ANALOG_RESOLUTION  // <- for a thermistor calibration
  );


  display.begin(SSD1306_SWITCHCAPVCC, 0x3c);
  display.clearDisplay();
  display.drawBitmap(0, 0, chevy, 128, 64, WHITE);
  display.display();
  delay(2000);
  digitalWrite(rel_battery, HIGH);
  delay(3000);
}

void loop() {
  digitalWrite(PC13, !digitalRead(PC13));
    display.clearDisplay();
  display.setTextColor(WHITE);

  showVoltage(readVoltage());
  showTemperature(readTemperature());




  if (readVoltage() < 11.5) {

    showWarning();

    display.clearDisplay();
    display.setCursor(25, 10);
    display.setTextSize(2);
    display.println("BATTERY");
    display.setCursor(50, 30);
    display.print("LOW");
    display.display();
    delay(5000);

    powerOff();
    delay(50000);
  }

  if (readTemperature() > 45) {

    showWarning();

    display.clearDisplay();
    display.setCursor(50, 0);
    display.println("HIGH");
    display.setCursor(28, 22);
    display.println("TEMPERATURE");
    display.setCursor(40, 42);
    display.print(readTemperature());
    display.print("o");
    display.print("C");
    display.display();

    delay(5000);
    powerOff();
    delay(300000);
  }
}